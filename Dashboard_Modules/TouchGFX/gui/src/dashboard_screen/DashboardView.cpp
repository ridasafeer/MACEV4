/*
 * File: DashboardView.cpp
 *
 * Summary: This file is the view for the main screen of the dashboard (the dashboard itself). The declaration of this
 * 			class can be found in the gui/include/dashboard_screen/DashboardView.hpp file.
 *
 * 			TouchGFX/STM32 uses a MVP (model, view, presenter) design, the supporting files for the model and presenter
 * 			can be found in the gui/src folder.
 *
 * 			The view file of a screen interacts directly with the GUI components. The structure should be setter/getter methods
 * 			for each of the non-static elements.
 *
 * NOTE: 	The majority of the code in this class was designed to test the TouchGFX UI quickly. It is garbage spaghetti code.
 * 			The goal is to wrap UI elements in additional classes to reduce any duplicated code and to make maintenance/changes
 * 			easier in the future. The handleTickEvent function will also be removed once this transition is complete.
 */

// Imports
#include <gui/dashboard_screen/DashboardView.hpp>
#include <texts/TextKeysAndLanguages.hpp>
#include <touchgfx/Color.hpp>
#include <gui/containers/ProgressWrapper.hpp>


// To be deleted once processing is moved to the Model class
// Temporary variables for demo purposes
int count = 0;
bool up = false;

//
// (To be moved to wrapper class for HV/LV indicators) Configuration variables
//
// Set inactive colour for indicators
touchgfx::colortype INACTIVE_INDICATOR_COLOUR = touchgfx::Color::getColorFrom24BitRGB(56, 56, 56);

// DashboardView class constructor. GUI element setup is handled in the setupScreen function.
DashboardView::DashboardView() {}


/*
 * void setupScreen()
 *
 * Parameters: 		N/A
 *
 * Return value: N/A
 *
 * Description: 	This function is called any time the dashboard screen is to be displayed.
 */
void DashboardView::setupScreen() {
    DashboardViewBase::setupScreen();

    //
   	// Set up screen elements (wrappers)
   	//

   	// Define configuration and create bars
    // { minValue, maxValue, minColour, maxColour } (see include/gui/containers/ProgressWrapper.hpp for definition)
   	progessConfig redGreen = {0, 100, 0xFF0000, 0x00FF00};
   	progessConfig greenRed = {0, 100, 0x00FF00, 0xFF0000};

   	// Configuration for motor temperatures will go from 0 --> X degrees
   	// progressConfig motorTemp = {0, 150, 0xFF0000, 0x00FF00};

   	this->batterySOC = new ProgressWrapper(&batterySOCProgress, greenRed);
   	this->batteryTemp = new ProgressWrapper(&batteryTempProgress, redGreen);

}


/*
 * void tearDownScreen()
 *
 * Parameters: 		N/A
 *
 * Return value: N/A
 *
 * Description: 	This function is called any time the dashboard screen is finished being displayed
 * 					and another screen will be replacing it.
 */
void DashboardView::tearDownScreen() {
    DashboardViewBase::tearDownScreen();
}


/*
 * void setBatteryTemp(int val)
 *
 * Parameters: 		int temp - Integer representing the updated battery temperature.
 *
 * Return value: N/A
 *
 * Description: 	The setBatteryTemp function updates the batter temperature UI elements
 * 					with a passed value from the DashboardPresenter class.
 */
void DashboardView::setBatteryTemp(int temp){
	batteryTemp->setValue(temp);
}

/*
 * void setMotorTemps(int leftRear, rightRear, leftFront, rightFront)
 *
 * Parameters:		int left/rightRear/Front - Integer representing the temperature of the corresponding
 * 											   motor.
 *
 * Description: 	This function will update all of the motor temperatures using the passed
 * 					parameters. The function will directly access the progress bars and the supplied data
 * 					will be generated by the dashboard presenter class.
 *
 * 					*** To be implemented (in model (+modelListener) and presenter as well) ***
 */

/*
 * void setLVIndicator(bool status)
 *
 * Parameters:		bool status - The value to set the indicator to (true for on, false for off)
 *
 * Description: 	This function will update the LV status indicator on the dashboard. The passed paramter
 * 					is the status to set the indicator to.
 *
 * 					*** To be implemented (in model (+modelListener) and presenter as well) ***
 * 					*** Needs to have wrapper implemented (HV and LV are shared) ***
 */

/*
 * void setHVIndicator(bool status)
 *
 * Parameters:		bool status - The value to set the indicator to (true for on, false for off)
 *
 * Description: 	This function will update the HV status indicator on the dashboard. The passed paramter
 * 					is the status to set the indicator to.
 *
 * 					*** To be implemented (in model (+modelListener) and presenter as well) ***
 * 					*** Needs to have wrapper developed (HV and LV are shared) ***
 */


/*
 * This method is to be deleted. Currently implemented for testing TouchGFX only.
 * Everything in this method should be moved to the Model.cpp file.
 */
void DashboardView::handleTickEvent() {

	// Move progress bars
	if (count % 2 == 0){

		// Motor temperature progress bars
		backRightMotorTempProgress.setValue(count/1.8);
		backLeftMotorTempProgress.setValue((100-count)/3);
		frontRightMotorTempProgress.setValue(count % 25);
		frontLeftMotorTempProgress.setValue(count);
	}

	// Flash boxes
	if (count % 50 >= 25){
		lvIndicator.setColor(touchgfx::Color::getColorFrom24BitRGB(31,195,56));
		lvIndicator.setBorderColor(touchgfx::Color::getColorFrom24BitRGB(24,150,43));
	} else {
		lvIndicator.setColor(touchgfx::Color::getColorFrom24BitRGB(255,255,255));
		lvIndicator.setBorderColor(INACTIVE_INDICATOR_COLOUR);
	}

	lvIndicator.invalidate();

	if (count % 35 >= 15){
		hvIndicator.setColor(touchgfx::Color::getColorFrom24BitRGB(255,195,31));
		hvIndicator.setBorderColor(touchgfx::Color::getColorFrom24BitRGB(255,153,20));
	} else {
		hvIndicator.setColor(touchgfx::Color::getColorFrom24BitRGB(255,255,255));
		hvIndicator.setBorderColor(INACTIVE_INDICATOR_COLOUR);
	}

	hvIndicator.invalidate();

	// Set center text
	Unicode::snprintf(center_textBuffer, 10, "%d", count);
	center_text.invalidate();

	// Calc count value (up or down, add/subtract)
	if (count >= 100)
		up = false;
	else if(count <= 0)
		up = true;

	if (up)
		count++;
	else
		count--;
}
